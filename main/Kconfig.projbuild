## main/Kconfig.projbuild
```kconfig
menu "SmartLED Configuration"

menu "Blink Configuration"

config BLINK_GPIO
    int "Blink GPIO number"
	range 0 34
	default 2
	help
		GPIO number (IOxx) to blink on and off.

		Some GPIOs are used for other purposes (flash connections, etc.) and cannot be used to blink.

		GPIOs 35-39 are input-only so cannot be used as outputs.

endmenu

menu "OneNET Configuration"

config DEVICE_ID
    string "ONENET_DEVICE_ID"
    help
        mqtt client id.

config PROJECT_ID
    string "ONENET_PROJECT_ID"
    help
        mqtt username.

config AUTH_INFO
    string "ONENET_AUTH_INFO"
    help
        mqtt password.

config DATA_STREAM
    string "ONENET_DATA_STREAM"
    help
        datastream name.

endmenu

endmenu
```
